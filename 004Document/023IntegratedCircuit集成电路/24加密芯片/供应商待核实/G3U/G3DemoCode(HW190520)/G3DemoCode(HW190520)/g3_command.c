/** 
  *****************************************************************************
  * @file    		    : G3_command.c
  * @author         : Miller IC Trust Key China
  * @version        : V1.1.0
  * @date           : 2-July-2018
  * @test processor : STM32F405RGT
  * @test compiler  : IAR ARM 7.7
  * @brief          : Command Marshaling Layer of G3 Library
  *****************************************************************************
  * Copyright (c) 2016 IC Truct Key Co., LTD. All rights reserved.
  */

#include <string.h>   // needed for memset(), memcpy()

#include "g3_command.h"
#include "g3_communication.h"
#include "ictk_lib.h"

/**
  * @brief  This function calculates CRC16.
  * @param  length number of bytes in buffer
  * @param  data pointer to data for which CRC should be calculated
  * @param  crc16 pointer to 16-bit CRC
  */
static void g3_calculate_crc16(uint8_t length, uint8_t *data, uint8_t *crc16)
{
	uint8_t counter;
	uint16_t crc16_register = 0;
        uint16_t polynomial = 0x8005;      
	uint8_t shift_register;
	uint8_t data_bit, crc16_bit;

	for(counter = 0; counter < length; counter++)
        {
	  for(shift_register = 0x01; shift_register > 0x00; shift_register <<= 1)
          {
            data_bit = (data[counter] & shift_register) ? 1 : 0;
            crc16_bit = crc16_register >> 15;

            crc16_register <<= 1;
            if((data_bit ^ crc16_bit) != 0)
                crc16_register ^= polynomial;
          }
	}
	crc16[0] = (uint8_t) (crc16_register);
	crc16[1] = (uint8_t) (crc16_register >> 8);
}

/**
  * @brief  This function checks the consistency of a response.
  * @param  response pointer to response
  * @return status of the consistency check
  */
static G3_StatusTypeDef g3_check_crc16(uint8_t *response)
{
	uint8_t crc16[2];
	uint8_t length;

	length = response[0] - 2;
	g3_calculate_crc16(length, response, crc16);

	return (crc16[0] == response[length] && crc16[1] == response[length + 1])
          ? G3_OK : G3_CRC_ERROR;
}


G3_StatusTypeDef g3_normal_process(uint8_t inst, uint8_t p1, uint16_t p2, uint8_t *data, uint8_t length,uint8_t **recv_buff)
{
  G3_StatusTypeDef ret_code;
   uint8_t tx_buffer[512];
   uint8_t rx_buffer[75];
   uint8_t rx_size;
  // 2. Make Packet
	tx_buffer[G3_LENGTH_INDEX]  = 7 + length;
	tx_buffer[G3_INSCODE_INDEX] = inst;
	tx_buffer[G3_P1_INDEX]      = p1;
	tx_buffer[G3_P2_INDEX]      = p2 >> 8;
	tx_buffer[G3_P2_INDEX + 1]  = p2;
  
  memcpy(tx_buffer + 5, data, length);
  // 3. Calculate CRC
  g3_calculate_crc16(length + 5, tx_buffer, tx_buffer + length + 5);
  
  // 4. Command & Response
  CMD_PRINTF("Send", tx_buffer);  
  ret_code = g3_c_send_and_receive(tx_buffer, rx_buffer);
    
    rx_size=rx_buffer[0];
  if(rx_size==4)
  {
    if((ret_code=rx_buffer[1] )!= G3_OK)
    return ret_code;
  }
  
  else  
  {
   memcpy(*recv_buff, rx_buffer+1, rx_size-3);
  }

  RSP_PRINTF("Receive", rx_buffer);  
  
  // 6. Check Checksum
  return g3_check_crc16(rx_buffer);  
}

G3_StatusTypeDef g3_normal_process_ok(uint8_t inst, uint8_t p1, uint16_t p2,uint8_t **recv_buff)
{
  G3_StatusTypeDef ret_code;
   uint8_t tx_buffer[512];
   uint8_t rx_buffer[75];
   uint8_t rx_size;
  // 2. Make Packet
	tx_buffer[G3_LENGTH_INDEX]  = READ_LENGTH;
	tx_buffer[G3_INSCODE_INDEX] = inst;
	tx_buffer[G3_P1_INDEX]      = p1;                                      
	tx_buffer[G3_P2_INDEX]      = p2 >> 8;
	tx_buffer[G3_P2_INDEX + 1]  = p2;
  
  // 3. Calculate CRC
  g3_calculate_crc16(tx_buffer[G3_LENGTH_INDEX] - 2, tx_buffer,
                        tx_buffer + tx_buffer[G3_LENGTH_INDEX] - 2);
  
  // 4. Command & Response
  CMD_PRINTF("Send", tx_buffer);  
  ret_code = g3_c_send_and_receive(tx_buffer, rx_buffer);
    
    rx_size=rx_buffer[0];
  if(rx_size==4)
  {
    if((ret_code=rx_buffer[1] )!= G3_OK)
    return ret_code;
  }
  
  else  
  {
   memcpy(*recv_buff, rx_buffer+1, rx_size-3);
  }

  RSP_PRINTF("Receive", rx_buffer);  
  
  // 6. Check Checksum
  return g3_check_crc16(rx_buffer);  
}

/**
  * @brief  Verifies a certificate, and then update a public key or store it in public key of temporary memory The session can be generated by the public key of temporary memory. 
  *  Parameters (0x8D)
  *      key_index                       : Key sector index(p1) 
  *      certification_write_mode        : The mode of certificate write It can be one of the following values : 
  *                                        TO_TEMP
  *                                        TO_KEY_SECTOR 
  *      cert                            : Input a certificate to verify 
  *      cert_size                       : The size of certificate
  *  Returns
  *      G3_StatusTypeDef
  */
G3_StatusTypeDef g3api_certification(uint8_t key_index, EN_CERTIFICATION_WRITE_MODE certification_write_mode, uint8_t * cert, int16_t cert_size)
{
  G3_StatusTypeDef ret_code;
  int16_t unit_size=240;
  int16_t remain_size = cert_size;
  uint8_t * psubcert = cert;
  
  uint8_t index = 0; 
	
  if (remain_size >1024 )
      return G3_INVALID_SIZE;
  
   PRINTF("\r\n######################g3api_certification######################\r\n");
   
   	while (remain_size>0)
	{
          	uint16_t realsize = min(remain_size, unit_size);
		if (remain_size <= unit_size)
		{
			index = 0xff;
		}
                
		ret_code = g3_normal_process(G3_CERT, key_index, MAKEWORD(index, certification_write_mode), psubcert, realsize,NULL);
       
                if(ret_code!= G3_OK)
                    return ret_code;
                              
		psubcert += unit_size;
		remain_size -= unit_size;
		
		index++;
	} 
   
          return ret_code;
}


/**
  * @brief  Changes the password of the target sector to input password key.. 
  *  Parameters (0x83)
  *      key_index                       : Key sector index(p1) 
  *      passwd                          : Input password key 
  *      passwd_size                     : The size of password key
  *  Returns
  *      G3_StatusTypeDef
  */
G3_StatusTypeDef g3api_change_password(uint8_t key_index, uint8_t * passwd, uint8_t passwd_size)
{
  
  if ((passwd_size >16)|| (passwd_size <4))
    return G3_INVALID_SIZE;
  
   PRINTF("\r\n######################g3api_change_password######################\r\n");
   
   return g3_normal_process(G3_CHANGE_PWD, key_index, 0x00, passwd, passwd_size,NULL);
  
}

/**
  * @brief  Decrypts a given cipher data using target key... 
  *  Parameters (0x89)
  *      key_index                       : Key sector index(p1) 
  *      key_type                        : The key type of the target key(p2_upper) 
  *                                         SECTOR_KEY 
  *                                         SESSION_KEY 
  *      block_mode                      : The block cipher operation mode(p2_lower) 
  *                                         BL_CBC 
  *                                         BL_CTR 
  *      iv                              : Initial vector 
  *      cipher                          : The cipher data to be decrypted 
  *      cipher_size                     : The size of cipher data 
  *      data                            : Output from the command, plain data 
  *  Returns
  *      G3_StatusTypeDef
  */

G3_StatusTypeDef g3api_decryption(uint8_t key_index, EN_KEY_TYPE key_type, EN_BLOCK_MODE block_mode, uint8_t* iv, uint8_t* cipher, uint8_t cipher_size, uint8_t* data)
{
  uint8_t send_buff[512];
 // uint8_t * recv_buff[];
  
   PRINTF("\r\n######################g3api_decryption######################\r\n");
  
   switch(block_mode)
   {
     case 0x20 :   // SM2 INIT
     case 0x22 :   // SM2 FINAL
     case 0x21 :   // SM2 UPDATE
       memcpy(send_buff, cipher, cipher_size);
       break;
     default :
       memcpy(send_buff, iv, 16);
       memcpy(send_buff+16, cipher, cipher_size);
       break;
   }
   
   if( iv != NULL )
      return g3_normal_process(G3_DECRYPT, key_index, MAKEWORD(block_mode, key_type), send_buff, cipher_size+16, &data);
   else
     return g3_normal_process(G3_DECRYPT, key_index, MAKEWORD(block_mode, key_type), send_buff, cipher_size, &data);
  
}


/**
  * @brief  Decrypt a given cipher data with ECIES. The target key must be a private key... 
  *  Parameters (0x89)
  *      key_index                       : Key sector index(p1) 
  *      rs                              : R (R=rG, r:random) - ECC private key, S=x of (rKB=kBR), r: random, KB : public key of B, kB : private key of B) 
  *                                        S (S=x of(rKB=kBR), r : random, KB : public key of B, kB : private key of B)
  *  Returns
  *      G3_StatusTypeDef
  */

G3_StatusTypeDef g3api_decryption_ecies(uint8_t key_index, uint8_t *r,uint8_t *s)
{
  
   PRINTF("\r\n######################g3api_decryption_ecies######################\r\n");
    
    return g3_normal_process(G3_DECRYPT, key_index, 0x10, r, 64, &s);
  
}

/**
  * @brief  Diversifies a symmetric key by using diversify AC.. 
  *  Note:
  *     It can be executed in two mode : self mode and inherit mode If rw_operation bits of the target key setting is 11, diversify command requires a MAC
  *  Parameters (0x8B)
  *      key_index                       : Key sector index(p1) 
  *      diversify_mode                  : The mode of diversify(p2) It can be one of the following values :  
  *                                         INHERIT_MODE 
  *                                         SELF_MODE 
  *      data                            : The parameter to be used for diversifying  
  *      data_size                       : The size of data 
  *  Returns
  *      G3_StatusTypeDef
  */

G3_StatusTypeDef g3api_diversify(uint8_t key_index,EN_DIVERSIFY_MODE diversify_mode,uint8_t* data,uint8_t data_size)
{
  
   PRINTF("\r\n######################g3api_diversify######################\r\n");
    
    return g3_normal_process(G3_DIVERSIFY, key_index, diversify_mode, data, data_size, NULL);
  
}

/**
  * @brief  Verifies the signature and obtain AC... 
  *  Note:
  *     Input signature must be generated using challenge that generated in G3
  *  Parameters (0x87)
  *      key_index                       : Key sector index(p1) 
  *      dauth_option                    : The mode of the command(p2_lower) It can be one of the following values :   
  *                                         DYN_AUTH_ECDSA_SHA256, DYN_AUTH_HMAC, DYN_AUTH_SYMM, DYN_AUTH_CERT_PUB_ECDSA_SHA256  
  *      pos_pub_dynamic                 : A random position(p2_upper)   
  *      msg                             :Input data, it contains data and signature 
  *      msg_size                        :The size of input data 
  *      sign_structure                  : Command outputs. It can be one of the following structures : 
  *                                         ST_SIGN_ECDSA : r[32] || s[32]  
  *                                         ST_SIGN_SYMM : sign[16]   
  *                                         ST_SIGN_HMAC : sign[32]                        
  *      structure_size                  : The size of sign_sturucture
  *  Returns
  *      G3_StatusTypeDef
  */

G3_StatusTypeDef g3api_dynamic_auth(uint8_t key_index, EN_DYNAMIC_AUTH dauth_option, uint8_t pos_pub_dynamic, uint8_t * msg, uint8_t msg_size, void * sign_structure, uint8_t structure_size)
{
  G3_StatusTypeDef ret_code;
  uint8_t * pbuff = (uint8_t *)malloc(msg_size + structure_size);
  
    PRINTF("\r\n######################g3api_verify_dynamic######################\r\n");   
  	switch (dauth_option)
	{
	case DYN_AUTH_ECDSA_SHA256:
	case DYN_AUTH_CERT_PUB_ECDSA_SHA256:
		if (structure_size != 64){
			return G3_INVAILD_DATA;
		}
		break;
		break;
	case DYN_AUTH_HMAC:
		if (structure_size != 32){
			return G3_INVAILD_DATA;
		}
		break;
	case DYN_AUTH_SYMM:
		if (structure_size !=16){
			return G3_INVAILD_DATA;
		}
		break;

	default:
		return G3_INVAILD_COMMAND;
	}
   
   	memcpy(pbuff, msg, msg_size);
	memcpy(pbuff + msg_size, sign_structure, structure_size);
                
	ret_code = g3_normal_process(G3_VERIFY,  key_index, MAKEWORD(dauth_option, pos_pub_dynamic), pbuff, msg_size + structure_size,NULL);

    	free(pbuff);
        
        return ret_code;
  
}
/**
  * @brief  Used for session key agreement... 
  *  Parameters (0x87)
  *      en_ecdh_mode                    :  The mode of ECDH instruction It can be one of the following values :   
  *                                         NORMAL_ECDH, GEN_TLS_BLOCK, SET_TLS_SESSION_KEY   
  *      Q_b                             :  The type of public key It can be one of the following values :    
  *                                         ST_ECC_PUBLIC : puk[64] 
  *                                         ST_ECC_PUBLIC_COMPRESS : puk[33] 
  *      Q_b_struct_size                 :The size of public key 
  *      st_ecdh_random                  :ServerHello.random[32] || ClientHello.random[32] 
  *      Q_chip                          : Command outputs, public key chip(dchipG)[64] 
  *      ecdh_value                      :Command outputs. It depends on the ECDH mode and can be one of the following values : 
  *                                         NORMAL_ECDH : pre_master_secret[32] 
  *                                         GEN_TLS_BLOCK : TLS_key_block[128]   
  *                                         SET_TLS_SESSION_KEY : client_write_IV[16] || server_write_IV[16]                      
  *      ecdh_value_struct_size          : The size of ecdh_value
  *  Returns
  *      G3_StatusTypeDef
  */

G3_StatusTypeDef g3api_ecdh(EN_ECDH_MODE en_ecdh_mode,  void* Q_b, uint8_t Q_b_struct_size, uint8_t* st_ecdh_random, uint8_t* Q_chip, void* ecdh_value, uint8_t ecdh_value_struct_size)
{
  G3_StatusTypeDef ret_code;
  uint8_t *buff;
  uint8_t *precvbuff = NULL;
        
     	memcpy(buff, Q_b, Q_b_struct_size);
        
    PRINTF("\r\n######################g3api_ecdh######################\r\n");       
  	switch (en_ecdh_mode)
	{
	case NORMAL_ECDH:
            ret_code = g3_normal_process(G3_ECDH, 0, en_ecdh_mode, buff, Q_b_struct_size, &precvbuff);
            if (ret_code < 0) 
            return ret_code;
        
		break;
	case GEN_TLS_BLOCK:
	case SET_TLS_SESSION_KEY:
            memcpy(buff+Q_b_struct_size, st_ecdh_random, 32);
            ret_code = g3_normal_process(G3_ECDH, 0, en_ecdh_mode, buff,Q_b_struct_size+32, &precvbuff);
            if (ret_code < 0) 
            return ret_code;
        
            break;
	}
  
   	memcpy(Q_chip, precvbuff, 64);
	memcpy(ecdh_value, precvbuff+64, ecdh_value_struct_size);

    	free(precvbuff);
    	free(buff);        
        return ret_code;
  
}


/**
  * @brief  Encrypts a given plain data using target key... 
  *  Parameters (0x88)
  *      key_index                       : Key sector index(p1) 
  *      key_type                        : The key type of the target key(p2_upper) 
  *                                         SECTOR_KEY 
  *                                         SESSION_KEY 
  *      block_mode                      : The block cipher operation mode(p2_lower) 
  *                                         BL_CBC 
  *                                         BL_CTR 
  *      iv                              : Initial vector 
  *      data                            : The plain data to be encrypted 
  *      data_size                       : The size of plain data  
  *      cipher                          : Output from the command, cipher data 
  *      cipher_size                     : The size of cipher data 

  *  Returns
  *      G3_StatusTypeDef
  */

G3_StatusTypeDef g3api_encryption(uint8_t key_index, EN_KEY_TYPE key_type, EN_BLOCK_MODE block_mode, uint8_t* iv, uint8_t* data, uint8_t data_size, uint8_t* cipher)
{
  uint8_t send_buff[512];
 // uint8_t * recv_buff[];
  
   PRINTF("\r\n######################g3api_encryption######################\r\n");
  
   switch(block_mode)
   {
     case 0x20 :   // SM2 INIT
     case 0x22 :   // SM2 FINAL
       break;
     case 0x21 :   // SM2 UPDATE
       memcpy(send_buff, data, data_size);
       break;
     default :
       memcpy(send_buff, iv, 16);
       memcpy(send_buff+16, data, data_size);
       break;
   }
   
   if( iv != NULL )
      return g3_normal_process(G3_ENCRYPT, key_index, MAKEWORD(block_mode, key_type), send_buff, data_size+16, &cipher);
   else
     return g3_normal_process(G3_ENCRYPT, key_index, MAKEWORD(block_mode, key_type), send_buff, data_size, &cipher);
}


/**
  * @brief  Encrypts a given plain data with ECIES. The target key must be a public key... 
  *  Parameters (0x88)
  *      key_index                       : Key sector index(p1) 
  *      rs                              : R (R=rG, r:random) - ECC private key, S=x of (rKB=kBR), r: random, KB : public key of B, kB : private key of B) 
  *  Returns
  *      G3_StatusTypeDef
  */

G3_StatusTypeDef  g3api_encryption_ecies(uint8_t key_index, uint8_t *rs)
{
  
   PRINTF("\r\n######################g3api_encryption_ecies######################\r\n");
    
    return g3_normal_process_ok(G3_ENCRYPT, key_index, 0x10,&rs);
  
}


/**
  * @brief  Generates challenge and loads it to temporary memory... 
  *  Note:
  *     Whenever the generated challenge is used once for an authentication, the callenge becomes invalidated, regardless of whether the authentication has been passed or not.
  *  Parameters (0x84)
  *      chall_size                      : The size of challenge to get 
  *      challenge                       : The buffer to put challenge  
  *  Returns
  *      G3_StatusTypeDef
  */

G3_StatusTypeDef  g3api_get_challenge(uint8_t chall_size, uint8_t * challenge)
{    
        
   PRINTF("\r\n######################g3api_get_challenge######################\r\n");    

         return g3_normal_process_ok(G3_GET_CHAL, chall_size, 0,&challenge);
}


/**
  * @brief  Outputs a public key in a compress form(33bytes) or X,Y coordinate form(64 bytes).. 
  *  Parameters (0x8C)
  *      key_index                       : Key sector index(p1) 
  *      pub_type                        : The type of public key It can be one of the following values :  
  *                                         KEY_SECTOR 
  *                                         TEMP_PUBLIC_KEY 
  *      pub_key                         : The buffer to put the public key. It can be one of the following values : 
  *                                         ST_ECC_PUBLIC : puk[64]  
  *                                         ST_ECC_PUBLIC_COMPRESS : puk[33]  
  *      structure_size                  : The size of buffer  
  *  Returns
  *      G3_StatusTypeDef
  */


G3_StatusTypeDef  g3api_get_public_key(uint8_t key_index, EN_PUB_TYPE pub_type, void* pub_key, uint8_t structure_size)
{    
  uint8_t lowerbyte;     
   PRINTF("\r\n######################g3api_get_public_key######################\r\n");    
   
	switch (structure_size)
        {
	case 0x40 :
		lowerbyte = 1;
		break;
	case 0x21:
		lowerbyte = 0;
		break;
									

	default:
		return G3_INVALID_SIZE;
	}
                  
	return g3_normal_process_ok(G3_GET_PUB_KEY,  key_index, MAKEWORD(lowerbyte, pub_type),&pub_key);

}




/**
  * @brief  Writes the revision value to the target sector, the target sector should be an ECC PUF... 
  *  Parameters (0x85)
  *      key_index                       : Key sector index(p1) 
  *      initial                         : The revision value (4 bytes) 
  *  Returns
  *      G3_StatusTypeDef
  */

G3_StatusTypeDef   g3api_init_puf(uint8_t key_index, uint8_t *initial)
{    
        
   PRINTF("\r\n######################g3api_init_puf######################\r\n");    

         return g3_normal_process(G3_INIT_PRIV_KEY, key_index, 0,initial,4,NULL);
}


/**
  * @brief  Issues a certificate and store it. Add the pair public key of private key in target sector to certificate The length of the certificate cannot exceed 1024 bytes... 
  *  Parameters (0x8E)
  *      key_index                       : Key sector index(p1) 
  *      public_key_pos                  : The public key position 
  *      issue_cert_area_type            : The area type of the sector to store the issued certificate It can be one of the following values : 
  *                                         ISCRT_KEY_AREA   
  *                                         ISCRT_DATA_AREA_0 
  *                                         ISCRT_DATA_AREA_1  
  *      sector_num_to_store             :The sector number to store the issued certificate 
  *      key_id                          :Factory key ID or the sector number of private key 
  *      encrypted_key                   : When using key_id as a factory key id, encrypted_key must be given                       
  *      cert                            : Input TBS certificate 
  *      cert_size                       : The size of tbs certificate
  *  Returns
  *      G3_StatusTypeDef
  */

G3_StatusTypeDef g3api_issue_certification(uint8_t key_index, uint16_t public_key_pos, EN_ISSUE_CERT_AREA_TYPE issue_cert_area_type, uint8_t sector_num_to_store, uint16_t key_id, uint8_t* encrypted_key, uint8_t * cert, uint16_t cert_size)
{
  G3_StatusTypeDef ret_code;
  int16_t unit_size=240;
  int16_t remain_size = cert_size;
  uint8_t * psubcert = cert;
  uint8_t buff[64];
        
  uint8_t index = 0; 
	
  if (remain_size >935 )
      return G3_INVALID_SIZE;
  
     PRINTF("\r\n######################g3api_issue_certification######################\r\n");
	while (remain_size>0)
	{
		uint16_t realsize = min(remain_size, unit_size);

		uint8_t unit_pub_pos = -1;
		if (public_key_pos < unit_size && public_key_pos>=0) unit_pub_pos = public_key_pos;
		ret_code = g3_normal_process(G3_ISSUE_CERT, key_index, MAKEWORD(index, unit_pub_pos), psubcert, realsize,NULL);
       
                if(ret_code!= G3_OK)
                    return ret_code;
                
		psubcert += unit_size;
		remain_size -= unit_size;
		public_key_pos -= unit_size;

		index++;
	};

	index = 0xff;
	buff[0] = issue_cert_area_type;
	buff[1] = sector_num_to_store;
        buff[2] = key_id >> 8;
	buff[3] = key_id;
        
	if (encrypted_key)
	{
		memcpy(&buff[4], encrypted_key, 32);
		ret_code = g3_normal_process(G3_ISSUE_CERT, key_index, 0XFFFF, buff, 4+32,NULL);
	}
	else
	{
		ret_code = g3_normal_process(G3_ISSUE_CERT, key_index, 0XFFFF, buff, 4,NULL);
	}

	return ret_code;      
  
}



/**
  * @brief  Read value from the setup area, key area and user data area... 
  *  Parameters (0x80)
  *      key_index                       : Key sector index(p1) 
  *      area_type                       : The type of area to read ( p2_lower ) It can be one of the following values : 
  *                                         SETUP_AREA  
  *                                         KEY_AREA 
  *                                         DATA_AREA_0  
  *                                         DATA_AREA_1  
  *      rw_type                         : Read operation mode(p2_upper) It can be one of the following values : 
  *                                         PLAIN_TEXT - plain read 
  *                                         CBC, CTR, SESSION_KEY_CBC, SESSION_KEY_CTR - encrypted read 
  *                                         CBC_with_MAC, CTR_with_MAC, SESSION_KEY_CBC_with_MAC, SESSION_KEY_CTR_with_MAC - encrypted read with MAC 
  *                                         MASKED - masked read  
  *     data                             :Input data only for masked operation(rw_type -> MASKED) 
  *     data_size                        :The size of the mask 
  *      data_structure                  : Read data. it can be one of the following structures : 
  *                                         ST_RW_DATA : Data[32] - plain read, masked read 
  *                                         ST_RW_DATA_WITH_IV : Data[32] || IV[16] - encrypted read 
  *                                         ST_RW_DATA_WITH_IV_MAC : Data[32] || IV[16] || MAC[16] - encrypted read with MAC
  *      structure_size                  : The size of data_structure
  *  Returns
  *      G3_StatusTypeDef
  */

G3_StatusTypeDef g3api_read_key_value(uint8_t key_index, EN_AREA_TYPE area_type, EN_RW_INST_OPTION rw_type,void* data,uint8_t data_size,void* data_structure)
{
  PRINTF("\r\n######################g3api_read_key_value######################\r\n");
  if (rw_type == 0xFF)
    return g3_normal_process_ok(G3_READ, key_index, MAKEWORD(area_type, rw_type),&data_structure);
    else
       return g3_normal_process(G3_READ, key_index, MAKEWORD(area_type, rw_type),data, data_size,&data_structure); 
      
      return G3_INVALID_SIZE;      
  
}


/**
  * @brief  Reset the G3, and then initialize authentication results and a session... 
  *  Returns(0x9F)
  *      G3_StatusTypeDef
  */

G3_StatusTypeDef g3api_reset()
{    
        
   PRINTF("\r\n######################g3api_reset######################\r\n");    

         return g3_normal_process_ok(G3_RESET, 0, 0,NULL);
}


/**
  * @brief  Generates sessions and loads the session key to temporary memory... 
  *  Parameters (0x8A)
  *      key_index                       : Key sector index(p1) 
  *      en_session_mode                 : Session operation mode(p2) It can be one of the following values : 
  *                                         SYMM_KEY, FACTORY_AES, FACTORY_SM4, EXT_SESSION_KEY_AES, EXT_SESSION_KEY_SM4, EXT_PUB_KEY 
  *      indata                          : The parameter to be used for making a session key 
  *                                         SYMM_KEY : Sesssion_b[16] 
  *                                         FACTORY_AES/SM4 : Index[2] || Session_b[16] 
  *                                         EXT_SESSION_KEY_AES/SM4 : Session_key[16]   
  *                                         EXT_PUB_KEY : ECC public key[64or33]   
  *      indata_size                    :The size of input data 
  *      outdata                        :Output from the command 
  *                                         SYMM_KEY : Session_chip[16] || encrypt(0(zero),session_key)[16] 
  *                                         FACTORY_AES/SM4 : Encrypt(0(zero),session_key)[16] 
  *                                         EXT_SESSION_KEY_AES/SM4 : Encrypt(0(zero),session_key)[16] 
  *                                         EXT_PUB_KEY : SHA256(Input_data) 
  *      outdata_size                   : The size of output      
  *  Returns
  *      G3_StatusTypeDef
  */

G3_StatusTypeDef g3api_session(uint8_t key_index,EN_SESSION_MODE en_session_mode, uint8_t* indata, uint8_t indata_size, uint8_t* outdata)
{
  PRINTF("\r\n######################g3api_session######################\r\n");
    return g3_normal_process(G3_SESSION, key_index, en_session_mode,indata, indata_size,&outdata);   
  
}

/**
  * @brief  Loads input public key to temporary memory... 
  *  Parameters (0x8A)
  *      pub_key                       :  Public key to load, enable 2 follow structure ST_ECC_PUBLIC and ST_ECC_PUBLIC_COMPRESS 
  *      structure_size                : The size of the public key 
  *      puk_hash                      : Output from the command, hashed data
  *  Returns
  *      G3_StatusTypeDef
  */

G3_StatusTypeDef g3api_set_extern_public_key(void* pub_key, uint8_t structure_size, uint8_t* puk_hash)
{
  PRINTF("\r\n######################g3api_set_extern_public_key######################\r\n");
    return g3_normal_process(G3_SESSION, 1, EXT_PUB_KEY,pub_key, structure_size,&puk_hash);   
  
}


/**
  * @brief  For HASH calculation. HASH command is executed in three steps : initialization, update and finalization... 
  *  Parameters (0x94)
  *      alg                          : The selection of alg 
  *      hash_mode                    : The step of HASH command 
  *      data                         : The data to be subjected to the hash operation  
  *      data_size                    : The size of input data 
  *      outdata                      : Outputs from the command, hashed data
  *  Returns
  *      G3_StatusTypeDef
  */

G3_StatusTypeDef g3api_hash(EN_SEL_HASH_ALG alg, EN_HASH_MODE hash_mode, uint8_t* data, uint16_t data_size, uint8_t* outdata)
{
  
  PRINTF("\r\n######################g3api_hash######################\r\n");
  
  if( hash_mode == 0x0000 )
	{
		return g3_normal_process_ok(G3_HASH, alg, hash_mode,NULL);
	}
	else if( hash_mode == 0x0001 )
	{
		return g3_normal_process(G3_HASH, alg, hash_mode, data, data_size,NULL);
	}
	else
	{
		return g3_normal_process_ok(G3_HASH, alg, hash_mode, &outdata);	
	} 
  
}



/**
  * @brief  Generates a signature using input data and target key... 
  *  Note:
  *     The signature algorithm is determined as the target key type.
  *  Parameters (0x86)
  *      key_index                       : Key sector index(p1) 
  *      sign_option                 : Signature algorithm.(p2) It can be one of the following values : 
  *                                         SIGN_ECDSA_EXT_SHA256,SIGN_ECDSA_WITH_SHA256 - The target key type must be ECC_PUF or ECC_PRV 
  *                                         SIGN_HMAC - The target key type must be SHA256 
  *                                         SIGN_SYMM, SIGN_SESSION_SYMM - The target key type must be AES128 or SM4 
  *      msg                          :  Input data to be used for generating a signature 
  *      msg_size                   :TThe size of msg 
  *      sign_structure                        :Command outputs. It can be one of the following structures : 
  *                                         ST_SIGN_ECDSA : r[32] || s[32] 
  *                                         ST_SIGN_SYMM : sign[16] 
  *                                         ST_SIGN_HMAC : sign[32]  
  *      structure_size                   : The size of sign_structure   
  *  Returns
  *      G3_StatusTypeDef
  */

G3_StatusTypeDef g3api_sign(uint8_t key_index, EN_SIGN_OPTION sign_option, uint8_t * msg, uint8_t msg_size, void * sign_structure, uint8_t structure_size)
{    
      PRINTF("\r\n######################g3api_sign######################\r\n");
        switch (sign_option)
	{
	case SIGN_ECDSA_EXT_SHA256:
        //case SIGN_SM2sign_EXT_SM3:  
	case SIGN_ECDSA_WITH_SHA256:
        //case SIGN_SM2sign_WITH_SM3:
		if (structure_size != 64){
			return G3_INVALID_SIZE;
		}
		break;
	case SIGN_HMAC:
		if (structure_size != 32){
			return G3_INVALID_SIZE;
		}
		break;
	case SIGN_SYMM:
	case SIGN_SESSION_SYMM:
		if (structure_size != 16){
			return G3_INVALID_SIZE;
		}
		break;
	default:
		return G3_INVALID_SIZE;
		break;
	}
  

    return g3_normal_process(G3_SIGN, key_index, sign_option,msg, msg_size,&sign_structure);   
}


/**
  * @brief  Verifies the signature... 
  *  Note:
  *     The target sector should be a public key or symmetric key To obtain AC, use the dynamic_auth.
  *  Parameters (0x87)
  *      key_index                       : Key sector index(p1) 
  *      verify_option                    : The option of command(p2) It can be one of the following values : 
  *                                         VERYFY_ECDSA_EXT_SHA256,VERIFY_SM2sign_EXT_SM2,VERYFY_ECDSA_WITH_SHA256,VERIFY_SM2sign_WITH_SM3,VERYFY_HMAC,VERYFY_SYMM,VERIFY_SESSION_SYMM, VERYFY_EXT_PUB_ECDSA_EXT_SHA256,VERYFY_EXT_PUB_ECDSA_WITH_SHA256 
  *      msg                             :Input data, it contains data and signature 
  *      msg_size                        :The size of input data 
  *      sign_structure                  : Command outputs. It can be one of the following structures : 
  *                                         ST_SIGN_ECDSA : r[32] || s[32]  
  *                                         ST_SIGN_SYMM : sign[16]   
  *                                         ST_SIGN_HMAC : sign[32]                        
  *      structure_size                  : The size of sign_sturucture
  *  Returns
  *      G3_StatusTypeDef
  */

G3_StatusTypeDef g3api_verify(uint8_t key_index, EN_VERIFY_OPTION verify_option, uint8_t * msg, uint8_t msg_size, void * sign_structure, uint8_t structure_size)
{
  G3_StatusTypeDef ret_code;
  uint8_t * pbuff = (uint8_t *)malloc(msg_size + structure_size);
  
         
   PRINTF("\r\n######################g3api_verify######################\r\n");   
	switch (verify_option)
	{
	case VERIFY_ECDSA_EXT_SHA256:
        //case VERIFY_SM2sign_EXT_SM3:
	case VERIFY_ECDSA_WITH_SHA256:
        //case VERIFY_SM2sign_WITH_SM3:  
	case VERIFY_EXT_PUB_ECDSA_EXT_SHA256:
	case VERIFY_EXT_PUB_ECDSA_WITH_SHA256:
		if (structure_size != 64){
			return G3_INVALID_SIZE;
		}

		break;
	case VERIFY_HMAC:
		if (structure_size != 32){
			return G3_INVALID_SIZE;
		}
		break;
	case VERIFY_SYMM:
	case VERIFY_SESSION_SYMM:
		if (structure_size != 16){
			return G3_INVALID_SIZE;
		}
		break;
		break;
	default:
		return G3_INVALID_SIZE;
		break;
	}

   
   	memcpy(pbuff, msg, msg_size);
	memcpy(pbuff + msg_size, sign_structure, structure_size);
                
	ret_code = g3_normal_process(G3_VERIFY,  key_index, verify_option, pbuff, msg_size + structure_size,NULL);

    	free(pbuff);
        
        return ret_code;
  
}

/**
  * @brief  Verifies the password of the target sector using input password key and obtain AC... 
  *  Parameters (0x82)
  *      key_index                     :  Key sector index(p1) 
  *      passwd                        : Input password key 
  *      passwd_size                   : The size of password key
  *  Returns
  *      G3_StatusTypeDef
  */

G3_StatusTypeDef g3api_verify_passwd(uint8_t key_index, uint8_t * passwd,uint8_t passwd_size)
{
  PRINTF("\r\n######################g3api_verify_passwd######################\r\n");
    return g3_normal_process(G3_VERIFY_PWD, key_index, 0,passwd, passwd_size,NULL);   
  
}


/**
  * @brief  Writes value in setup area, key area and user data area. 
  *  Parameters (0x81)
  *      key_index                       : Key sector index(p1) 
  *      area_type                       : The type of area to write. (p2_lower) It can be one of the following values : 
  *                                         SETUP_AREA  
  *                                         KEY_AREA 
  *                                         DATA_AREA_0  
  *                                         DATA_AREA_1  
  *      rw_type                         : Read operation mode(p2_upper) It can be one of the following values : 
  *                                         PLAIN_TEXT - plain read 
  *                                         CBC, CTR, SESSION_KEY_CBC, SESSION_KEY_CTR - encrypted read 
  *                                         CBC_with_MAC, CTR_with_MAC, SESSION_KEY_CBC_with_MAC, SESSION_KEY_CTR_with_MAC - encrypted read with MAC 
  *                                         MASKED - masked read  
  *      data_structure                  : Data to write. it can be one of the following structures : 
  *                                         ST_RW_DATA : Data[32] - plain read, masked read 
  *                                         ST_RW_DATA_WITH_IV : Data[32] || IV[16] - encrypted read 
  *                                         ST_RW_dATA_wITH_MASK : Data[32] || MASK[32] - masked write 
  *                                         ST_RW_DATA_WITH_IV_MAC : Data[32] || IV[16] || MAC[16] - encrypted read with MAC
  *      structure_size                  : The size of data_structure
  *  Returns
  *      G3_StatusTypeDef
  */

G3_StatusTypeDef g3api_write_key_value(uint8_t key_index, EN_AREA_TYPE area_type, EN_RW_INST_OPTION rw_type, void* data_structure, uint8_t structure_size)
{
     PRINTF("\r\n######################g3api_write_key_value######################\r\n");
         return g3_normal_process(G3_WRITE, key_index, MAKEWORD(area_type, rw_type),data_structure,structure_size,NULL); 
  
}


/************************ (c) COPYRIGHT 2016 ICTK Co., LTD. *****END OF FILE*****/
